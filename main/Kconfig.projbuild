## main/Kconfig.projbuild
```kconfig
menu "WiFi-MQTT Publisher Configuration"

    menu "WiFi Settings"
        config WIFI_SSID
            string "WiFi SSID"
            default "myssid"
            help
                Default SSID (network name). Can be overridden via web portal.

        config WIFI_PASSWORD
            string "WiFi Password"
            default "mypassword"
            help
                Default WiFi password. Can be overridden via web portal.

        config WIFI_MAX_RETRY
            int "Maximum WiFi reconnect retries"
            default 5
            help
                Number of retries before falling back to config portal.
    endmenu

    menu "MQTT Settings"
        config MQTT_BROKER_URI
            string "MQTT Broker URI"
            default "mqtt://test.mosquitto.org:1883"
            help
                Default MQTT broker URI. Can be overridden via web portal.

        config MQTT_TOPIC
            string "MQTT Publish Topic"
            default "home/esp32/dht11"
            help
                Default topic. Can be overridden via web portal.

        config MQTT_USERNAME
            string "MQTT Username (optional)"
            default ""
            help
                Username for MQTT broker authentication.

        config MQTT_PASSWORD
            string "MQTT Password (optional)"
            default ""
            help
                Password for MQTT broker authentication.
    endmenu

    menu "Sensor & Hardware"
        config DHT11_GPIO
            int "DHT11 Data GPIO Pin"
            default 4
            help
                GPIO pin connected to the DHT11 data pin.

        config SENSOR_READ_INTERVAL_SEC
            int "Sensor read interval (seconds)"
            default 10
            help
                How often to read DHT11 and publish data (in seconds).

        config LED_GPIO
            int "Indicator LED GPIO Pin"
            default 8
            help
                GPIO pin for the status indicator LED.
    endmenu

endmenu
```
